## sdkconfig.defaults
```kconfig
# Pre-fill Wi-Fi STA credentials
CONFIG_WIFI_SSID="PTCL-BB"
CONFIG_WIFI_PASSWORD="03354132272"

# SPIFFS settings for storing handshake.pcap
CONFIG_SPIFFS_MAX_PARTITIONS=1
CONFIG_SPIFFS_CACHE=1
```
